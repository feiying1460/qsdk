## qca/feeds/ieee1905-security/qca-ieee1905-security-config/qca-wsplcd/Config.in
```kconfig
config WSPLCD_SUPPORT_PLC
    bool "Support PLC credential cloning"
    depends on PACKAGE_qca-plc-serv
    default y
    help
        This enables the WSPLCD support for PLC interfaces
```
